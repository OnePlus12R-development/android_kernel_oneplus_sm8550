## drivers/input/touchscreen/oplus_touchscreen_v2/Focal/ft3683g/Kconfig
```kconfig
config TOUCHPANEL_FOCAL_FT3683G
	tristate "TP focal ft3683g IC enable or not for OPLUS"
	help
	Say Y to enable driver for Touchpanel using Focal FT3683G
	Say M to enable driver for Touchpanel using Focal FT3683G as module
```

## drivers/input/touchscreen/oplus_touchscreen_v2/Focal/ft8057p/Kconfig
```kconfig
config TOUCHPANEL_FOCAL_FT8057P
	tristate "TP focal ft8057p IC enable or not for OPLUS"
	help
	say Y to enable driver for Touchpanel using Focal FT8057P
	Say M to enable driver for Touchpanel using Focal FT8057P as module
```

## drivers/input/touchscreen/oplus_touchscreen_v2/Jadard/Kconfig
```kconfig
#
# Jadard Touchscreen driver configuration
#
source "drivers/input/touchscreen/oplus_touchscreen_v2/Jadard/jd9365tg/Kconfig"
```

## drivers/input/touchscreen/oplus_touchscreen_v2/Jadard/jd9365tg/Kconfig
```kconfig
#
# Jadard Touchscreen driver configuration
#
config TOUCHPANEL_JADARD_JD9365TG
#	default y
	tristate "TP Jadard jd9365tg IC enable or not for  OPLUS"
	help
	  Say M here if you have a Jadard chipset touchscreen.
	  If unsure, say N.
```

## drivers/input/touchscreen/oplus_touchscreen_v2/chipone/ICNL9916/Kconfig
```kconfig
config TOUCHPANEL_CHIPONE_ICNL9916
#	default y
	tristate "TP chipone icnl9916 IC enable or not for OPLUS"
	help
	Say Y to enable driver for Touchpanel useing chipone icnl9916
	Say M to enable driver for Touchpanel useing chipone icnl9916 as module
```

## drivers/input/touchscreen/oplus_touchscreen_v2/chipone/Kconfig
```kconfig
source "drivers/input/touchscreen/oplus_touchscreen_v2/chipone/ICNL9916/Kconfig"
```
